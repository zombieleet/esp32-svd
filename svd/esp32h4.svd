# ESP32-H4 register map
Vendor: ESPRESSIF SYSTEMS (SHANGHAI) CO., LTD.; Series: ESP32 H-Series; File version: 1
32-bit RISC-V MCU & Bluetooth 5.4 (LE) & IEEE 802.15.4
CPU: RV32IMAC r0p0, little endian, no MPU, no FPU, 0 interrupt priority bits
Address unit: 32 bits
Registers are 32-bit, read-write, reset 0x0 unless marked. A register's access mark holds for its fields unless they carry their own. Offsets are from the block's base; lines under a group give offsets from that group; [hi:lo] are bit positions; {n}, {i} and the like mark numbered series; 'fields as' and 'values as' point back to an identical list; <NAME> marks a mode.

## Memory map
0x20000000 CLINT size 0xC000 — Core Local Interrupts
0x20010000 CLINT_OTHER_CORE size 0xC000 — Core Local Interrupts of the other core
0x20800000 CLIC size 0x10C0 — Core Local Interrupt Controller
0x60002000 BUS_MONITOR size 0x11C — BUS_MONITOR Peripheral
0x60005000 INTPRI size 0x24 — INTPRI Peripheral
0x60008000 CACHE size 0x3F4 — CACHE Peripheral
0x60010000 SPI2 size 0x98 — SPI (Serial Peripheral Interface) Controller 2
0x60011000 SPI3 size 0x98 — SPI (Serial Peripheral Interface) Controller 3
0x60012000 UART0 size 0x98 — UART (Universal Asynchronous Receiver-Transmitter) Controller 0
0x60013000 UART1 size 0x98 — UART (Universal Asynchronous Receiver-Transmitter) Controller 1
0x60014000 UHCI0 size 0x84 — Universal Host Controller Interface 0
0x60015000 I2C0 size 0x90 — I2C (Inter-Integrated Circuit) Controller 0
0x60016000 I2C1 size 0x90 — I2C (Inter-Integrated Circuit) Controller 1
0x60017000 I2S0 size 0x8C — I2S (Inter-IC Sound) Controller 0
0x60018000 PARL_IO size 0x58 — Parallel IO Controller
0x60019000 MCPWM0 size 0x148 — Motor Control Pulse Width Modulator (MCPWM) Peripheral
0x6001A000 MCPWM1 size 0x148 — Motor Control Pulse-Width Modulation 1
0x6001B000 LEDC size 0x12C — LED Control PWM (Pulse Width Modulation)
0x6001C000 TWAI0 size 0xC8 — Two-Wire Automotive Interface
0x6001D000 USB_DEVICE size 0x78 — Full-speed USB Serial/JTAG Controller
0x6001E000 RMT size 0x78 — Remote Control
0x6001F000 DMA size 0x370 — DMA (Direct Memory Access) Controller
0x60020000 PAU size 0x30 — PAU Peripheral
0x60021000 SOC_ETM size 0x218 — Event Task Matrix
0x60022000 APB_SARADC size 0x70 — SAR (Successive Approximation Register) Analog-to-Digital Converter
0x60023000 SYSTIMER size 0x90 — System Timer
0x60025000 MEM_MONITOR size 0x3C — MEM_MONITOR Peripheral
0x60026000 PVT size 0x1F4 — PVT Peripheral
0x60027000 PCNT size 0x78 — Pulse Count Controller
0x60028000 ASRC size 0x80 — ASRC Peripheral
0x60029000 ZERO_DET size 0x44 — ZERO_DET Peripheral
0x60040000 USB0 size 0x2A0 — USB OTG (On-The-Go)
0x6007F000 USB1 size 0x2A0 — USB1 Peripheral
0x60080000 USB_WRAP size 0xC — USB_WRAP Peripheral
0x60090000 TIMG0 size 0x8C — Timer Group 0
0x60091000 TIMG1 size 0x8C — Timer Group 1
0x60092000 IO_MUX size 0xA4 — Input/Output Multiplexer
0x60093000 GPIO size 0x394 — General Purpose Input/Output
0x60093E00 GPIO_SD size 0x80 — Sigma-Delta Modulation
0x60094000 PCR size 0x1B4 — PCR Peripheral
0x60098000 SPI0 size 0x174 — SPI (Serial Peripheral Interface) Controller 0
0x60099000 SPI1 size 0xB0 — SPI (Serial Peripheral Interface) Controller 1
0x6009A000 INTERRUPT_CORE0 size 0x1B8 — Interrupt Controller (Core 0)
0x6009B000 INTERRUPT_CORE1 size 0x800 — Interrupt Controller for Core 1
0x6009C000 HP_SYS size 0xA4 — High-Power System
0x6009D000 HP_APM size 0x124 — HP_APM Peripheral
0x6009E000 CPU_APM size 0xB4 — CPU_APM Peripheral
0x6009F000 TEE size 0x150 — TEE Peripheral
0x600A5000 KEYMNG size 0xD8 — KEYMNG Peripheral
0x600A6000 AES size 0xC8 — AES (Advanced Encryption Standard) Accelerator
0x600A7000 SHA size 0xF4 — SHA (Secure Hash Algorithm) Accelerator
0x600A8000 ECC size 0x138 — ECC (ECC Hardware Accelerator)
0x600A9000 HMAC size 0xA4 — HMAC (Hash-based Message Authentication Code) Accelerator
0x600AA000 ECDSA size 0x168 — ECDSA (Elliptic Curve Digital Signature Algorithm) Accelerator
0x600B1000 HUK size 0x1A8 — HUK Peripheral
0x600B1400 LP_TEE size 0x54 — Low-power Trusted Execution Environment
0x600B1800 EFUSE size 0x3DC — eFuse Controller
0x600B2000 RNG size 0x10 — Hardware Random Number Generator
0x600B2400 PMU size 0x1CC — PMU Peripheral
0x600B2800 LP_AON size 0x94 — LP_AON Peripheral
0x600B2C00 LP_ANA size 0x44 — LP_ANA Peripheral
0x600B3000 LP_CLKRST size 0x4C — LP_CLKRST Peripheral
0x600B3400 LP_PERI size 0x1C — LP_PERI Peripheral
0x600B3800 LP_IO_MUX size 0x1C — Low-power Input/Output Multiplexer
0x600B3C00 LP_GPIO size 0x64 — Low-power General Purpose Input/Output
0x600B5000 LP_TIMER size 0x4C — Low-power Timer
0x600B5400 LP_WDT size 0x3C — Low-power Watchdog Timer
0x600B5800 TOUCH size 0x64 — TOUCH Peripheral
0x600B5C00 TOUCH_AON size 0x100 — TOUCH_AON Peripheral
0x600C9C00 MODEM_SYSCON
0x600CF000 MODEM_LPCON
0x600CF800 I2C_ANA_MST — I2C_ANA_MST Peripheral

## Interrupts
0 WIFI_MAC (INTERRUPT_CORE0)
1 WIFI_MAC_NMI (INTERRUPT_CORE0)
2 WIFI_PWR (INTERRUPT_CORE0)
3 WIFI_BB (INTERRUPT_CORE0)
4 BT_MAC (INTERRUPT_CORE0)
5 BT_BB (INTERRUPT_CORE0)
6 BT_BB_NMI (INTERRUPT_CORE0)
7 LP_TIMER (INTERRUPT_CORE0)
8 COEX (INTERRUPT_CORE0)
9 BLE_TIMER (INTERRUPT_CORE0)
10 BLE_SEC (INTERRUPT_CORE0)
11 I2C_MST (INTERRUPT_CORE0)
12 ZB_MAC (INTERRUPT_CORE0)
13 MODEM_APB_TIMEOUT (INTERRUPT_CORE0)
14 BT_MAC_INT1 (INTERRUPT_CORE0)
15 PMU (INTERRUPT_CORE0)
16 EFUSE (INTERRUPT_CORE0)
17 LP_RTC_TIMER (INTERRUPT_CORE0)
18 LP_RTC_BLE_TIMER (INTERRUPT_CORE0)
19 LP_WDT (INTERRUPT_CORE0)
20 TOUCH (INTERRUPT_CORE0)
21 HUK (INTERRUPT_CORE0)
22 LP_PERI_PMS (INTERRUPT_CORE0)
23 FROM_CPU_INTR0 (INTERRUPT_CORE0)
24 FROM_CPU_INTR1 (INTERRUPT_CORE0)
25 FROM_CPU_INTR2 (INTERRUPT_CORE0)
26 FROM_CPU_INTR3 (INTERRUPT_CORE0)
27 BUS_MONITOR (INTERRUPT_CORE0)
28 CORE0_TRACE (INTERRUPT_CORE0)
29 CORE1_TRACE (INTERRUPT_CORE0)
30 CACHE (INTERRUPT_CORE0)
31 CPU_PERI_TIMEOUT (INTERRUPT_CORE0)
32 GPIO (INTERRUPT_CORE0)
33 GPIO_INT1 (INTERRUPT_CORE0)
34 PAU (INTERRUPT_CORE0)
35 HP_PERI_TIMEOUT (INTERRUPT_CORE0)
36 HP_APM_M0 (INTERRUPT_CORE0)
37 HP_APM_M1 (INTERRUPT_CORE0)
38 HP_APM_M2 (INTERRUPT_CORE0)
39 HP_APM_M3 (INTERRUPT_CORE0)
40 HP_APM_M4 (INTERRUPT_CORE0)
41 HP_MEM_APM_M0 (INTERRUPT_CORE0)
42 HP_MEM_APM_M1 (INTERRUPT_CORE0)
43 HP_MEM_APM_M2 (INTERRUPT_CORE0)
44 HP_MEM_APM_M3 (INTERRUPT_CORE0)
45 CPU_APM_M0 (INTERRUPT_CORE0)
46 CPU_APM_M1 (INTERRUPT_CORE0)
47 CPU_APM_M2 (INTERRUPT_CORE0)
48 CPU_APM_M3 (INTERRUPT_CORE0)
49 HP_PERI_PMS (INTERRUPT_CORE0)
50 MODEM_PERI_PMS (INTERRUPT_CORE0)
51 CPU_PERI_PMS (INTERRUPT_CORE0)
52 MSPI (INTERRUPT_CORE0)
53 I2S (INTERRUPT_CORE0)
54 UHCI0 (INTERRUPT_CORE0)
55 UART0 (INTERRUPT_CORE0)
56 UART1 (INTERRUPT_CORE0)
57 LEDC (INTERRUPT_CORE0)
58 TWAI0 (INTERRUPT_CORE0)
59 TWAI0_TIMER (INTERRUPT_CORE0)
60 USB_DEVICE (INTERRUPT_CORE0)
61 RMT (INTERRUPT_CORE0)
62 I2C_EXT0 (INTERRUPT_CORE0)
63 I2C_EXT1 (INTERRUPT_CORE0)
64 TG0_T0_LEVEL (INTERRUPT_CORE0)
65 TG0_WDT_LEVEL (INTERRUPT_CORE0)
66 TG1_T0_LEVEL (INTERRUPT_CORE0)
67 TG1_WDT_LEVEL (INTERRUPT_CORE0)
68 SYSTIMER_TARGET0 (INTERRUPT_CORE0)
69 SYSTIMER_TARGET1 (INTERRUPT_CORE0)
70 SYSTIMER_TARGET2 (INTERRUPT_CORE0)
71 APB_ADC (INTERRUPT_CORE0)
72 MCPWM0 (INTERRUPT_CORE0)
72 TEMPERATURE_SENSOR (INTERRUPT_CORE0)
73 MCPWM1 (INTERRUPT_CORE0)
74 PCNT (INTERRUPT_CORE0)
75 PARL_IO_TX (INTERRUPT_CORE0)
76 PARL_IO_RX (INTERRUPT_CORE0)
77 USB_OTG11 (INTERRUPT_CORE0)
78 ASRC_CHNL0 (INTERRUPT_CORE0)
79 ASRC_CHNL1 (INTERRUPT_CORE0)
80 ZERO_DET (INTERRUPT_CORE0)
81 DMA_IN_CH0 (INTERRUPT_CORE0)
82 DMA_IN_CH1 (INTERRUPT_CORE0)
83 DMA_IN_CH2 (INTERRUPT_CORE0)
84 DMA_IN_CH3 (INTERRUPT_CORE0)
85 DMA_IN_CH4 (INTERRUPT_CORE0)
86 DMA_OUT_CH0 (INTERRUPT_CORE0)
87 DMA_OUT_CH1 (INTERRUPT_CORE0)
88 DMA_OUT_CH2 (INTERRUPT_CORE0)
89 DMA_OUT_CH3 (INTERRUPT_CORE0)
90 DMA_OUT_CH4 (INTERRUPT_CORE0)
91 GPSPI2 (INTERRUPT_CORE0)
92 GPSPI3 (INTERRUPT_CORE0)
93 AES (INTERRUPT_CORE0)
94 SHA (INTERRUPT_CORE0)
95 ECC (INTERRUPT_CORE0)
96 ECDSA (INTERRUPT_CORE0)
97 KM (INTERRUPT_CORE0)

## Licence text in the file
Copyright 2026 Espressif Systems (Shanghai) PTE LTD Licensed under the Apache License, Version 2.0 (the "License"); you may not use this file except in compliance with the License. You may obtain a copy of the License at http://www.apache.org/licenses/LICENSE-2.0 Unless required by applicable law or agreed to in writing, software distributed under the License is distributed on an "AS IS" BASIS, WITHOUT WARRANTIES OR CONDITIONS OF ANY KIND, either express or implied. See the License for the specific language governing permissions and limitations under the License.
