# ESP32-C6 register map
Vendor: ESPRESSIF SYSTEMS (SHANGHAI) CO., LTD.; Series: ESP32 C-Series; File version: 12
32-bit RISC-V MCU & 2.4 GHz Wi-Fi 6 & Bluetooth 5 (LE) & IEEE 802.15.4
CPU: RV32IMAC r0p0, little endian, no MPU, no FPU, 0 interrupt priority bits
Address unit: 32 bits
Registers are 32-bit, read-write, reset 0x0 unless marked. A register's access mark holds for its fields unless they carry their own. Offsets are from the block's base; lines under a group give offsets from that group; [hi:lo] are bit positions; {n}, {i} and the like mark numbered series; 'fields as' and 'values as' point back to an identical list; <NAME> marks a mode.

## Memory map
0x20000000 CLINT size 0x180 — Core Local Interrupts
0x20001000 PLIC_MX size 0x400 — PLIC Peripheral
0x20001400 PLIC_UX size 0x400 — PLIC Peripheral
0x60000000 UART0 size 0x98 — UART (Universal Asynchronous Receiver-Transmitter) Controller 0
0x60001000 UART1 size 0x98 — UART (Universal Asynchronous Receiver-Transmitter) Controller 1
0x60002000 SPI0 size 0x138 — SPI (Serial Peripheral Interface) Controller 0
0x60003000 SPI1 size 0xAC — SPI (Serial Peripheral Interface) Controller 1
0x60004000 I2C0 size 0x90 — I2C (Inter-Integrated Circuit) Controller 0
0x60005000 UHCI0 size 0x84 — Universal Host Controller Interface 0
0x60006000 RMT size 0x78 — Remote Control
0x60007000 LEDC size 0x154 — LED Control PWM (Pulse Width Modulation)
0x60008000 TIMG0 size 0x68 — Timer Group 0
0x60009000 TIMG1 size 0x68 — Timer Group 1
0x6000A000 SYSTIMER size 0x90 — System Timer
0x6000B000 TWAI0 size 0x80 — Two-Wire Automotive Interface
0x6000C000 I2S0 size 0x60 — I2S (Inter-IC Sound) Controller 0
0x6000D000 TWAI1 size 0x80 — Two-Wire Automotive Interface
0x6000E000 APB_SARADC size 0x70 — SAR (Successive Approximation Register) Analog-to-Digital Converter
0x6000F000 USB_DEVICE size 0x70 — Full-speed USB Serial/JTAG Controller
0x60010000 INTERRUPT_CORE0 size 0x148 — Interrupt Controller (Core 0)
0x60011000 ATOMIC size 0x14 — Atomic Locker
0x60012000 PCNT size 0x68 — Pulse Count Controller
0x60013000 SOC_ETM size 0x1B0 — Event Task Matrix
0x60014000 MCPWM0 size 0x130 — Motor Control Pulse Width Modulator (MCPWM) Peripheral
0x60015000 PARL_IO size 0x2C — Parallel IO Controller
0x60016000 HINF size 0x54 — HINF Peripheral
0x60017000 SLC size 0x1000 — SDIO SLC
0x60018000 SLCHOST size 0x104 — SLCHOST Peripheral
0x60080000 DMA size 0x1A4 — DMA (Direct Memory Access) Controller
0x60081000 SPI2 size 0x98 — SPI (Serial Peripheral Interface) Controller 2
0x60088000 AES size 0xBC — AES (Advanced Encryption Standard) Accelerator
0x60089000 SHA size 0xB0 — SHA (Secure Hash Algorithm) Accelerator
0x6008A000 RSA size 0x74 — RSA (Rivest Shamir Adleman) Accelerator
0x6008B000 ECC size 0x78 — ECC (ECC Hardware Accelerator)
0x6008C000 DS size 0xA5C — Digital Signature
0x6008D000 HMAC size 0xA4 — HMAC (Hash-based Message Authentication Code) Accelerator
0x60090000 IO_MUX size 0x88 — Input/Output Multiplexer
0x60091000 GPIO size 0x39C — General Purpose Input/Output
0x60091F00 GPIO_SD size 0x7C — Sigma-Delta Modulation
0x60092000 MEM_MONITOR size 0x30 — MEM_MONITOR Peripheral
0x60093000 PAU size 0x4C — PAU Peripheral
0x60095000 HP_SYS size 0x5C — High-Power System
0x60096000 PCR size 0x14C — PCR Peripheral
0x60098000 TEE size 0x88 — TEE Peripheral
0x60099000 HP_APM size 0x114 — HP_APM Peripheral
0x60099800 LP_APM0 size 0x54 — LP_APM0 Peripheral
0x600A3000 IEEE802154 size 0x174 — IEEE802154 Peripheral
0x600A9800 MODEM_SYSCON size 0x28 — MODEM_SYSCON Peripheral
0x600AF000 MODEM_LPCON size 0x30 — MODEM_LPCON Peripheral
0x600AF800 I2C_ANA_MST — I2C_ANA_MST Peripheral
0x600B0000 PMU size 0x1A8 — PMU Peripheral
0x600B0400 LP_CLKRST size 0x34 — LP_CLKRST Peripheral
0x600B0800 EFUSE size 0x1D0 — eFuse Controller
0x600B0C00 LP_TIMER size 0x4C — Low-power Timer
0x600B1000 LP_AON size 0x5C — LP_AON Peripheral
0x600B1400 LP_UART size 0x84 — Low-power UART (Universal Asynchronous Receiver-Transmitter) Controller
0x600B1800 LP_I2C0 size 0x88 — Low-power I2C (Inter-Integrated Circuit) Controller 0
0x600B1C00 LP_WDT size 0x38 — Low-power Watchdog Timer
0x600B2000 LP_IO size 0x7C — LP_IO Peripheral
0x600B2400 LP_I2C_ANA_MST size 0x1C — LP_I2C_ANA_MST Peripheral
0x600B2800 LP_PERI size 0x28 — LP_PERI Peripheral
0x600B2C00 LP_ANA size 0x34 — LP_ANA Peripheral
0x600B3400 LP_TEE size 0x10 — Low-power Trusted Execution Environment
0x600B3800 LP_APM size 0x64 — Low-power Access Permission Management Controller
0x600B3C00 OTP_DEBUG size 0x210 — OTP_DEBUG Peripheral
0x600C0000 TRACE size 0x30 — RISC-V Trace Encoder
0x600C2000 ASSIST_DEBUG size 0x80 — Debug Assist
0x600C5000 INTPRI size 0xB8 — INTPRI Peripheral
0x600C8000 EXTMEM size 0x3C8 — External Memory

## Interrupts
0 WIFI_MAC (INTERRUPT_CORE0)
1 WIFI_MAC_NMI (INTERRUPT_CORE0)
2 WIFI_PWR (INTERRUPT_CORE0)
3 WIFI_BB (INTERRUPT_CORE0)
4 BT_MAC (INTERRUPT_CORE0)
5 BT_BB (INTERRUPT_CORE0)
6 BT_BB_NMI (INTERRUPT_CORE0)
7 LP_TIMER (INTERRUPT_CORE0)
8 COEX (INTERRUPT_CORE0)
9 BLE_TIMER (INTERRUPT_CORE0)
10 BLE_SEC (INTERRUPT_CORE0)
11 I2C_MASTER (I2C0)
12 ZB_MAC (INTERRUPT_CORE0)
13 PMU
14 EFUSE
15 LP_RTC_TIMER (LP_TIMER)
16 LP_UART
17 LP_I2C (LP_I2C0)
18 LP_WDT
19 LP_PERI_TIMEOUT (LP_PERI)
20 LP_APM_M0 (LP_APM)
21 LP_APM_M1 (LP_APM)
22 FROM_CPU_INTR0 (INTERRUPT_CORE0)
23 FROM_CPU_INTR1 (INTERRUPT_CORE0)
24 FROM_CPU_INTR2 (INTERRUPT_CORE0)
25 FROM_CPU_INTR3 (INTERRUPT_CORE0)
26 ASSIST_DEBUG
27 TRACE
28 CACHE (INTERRUPT_CORE0)
29 CPU_PERI_TIMEOUT (INTERRUPT_CORE0)
30 GPIO
31 GPIO_NMI (GPIO)
32 PAU
33 HP_PERI_TIMEOUT (HP_SYS)
34 MODEM_PERI_TIMEOUT (HP_SYS)
35 HP_APM_M0 (HP_APM)
36 HP_APM_M1 (HP_APM)
37 HP_APM_M2 (HP_APM)
38 HP_APM_M3 (HP_APM)
39 LP_APM0 (LP_APM)
40 MSPI (SPI2)
41 I2S0
42 UHCI0
43 UART0
44 UART1
45 LEDC
46 TWAI0
47 TWAI1
48 USB_DEVICE
49 RMT
50 I2C_EXT0 (I2C0)
51 TG0_T0_LEVEL (TIMG0)
52 TG0_T1_LEVEL (TIMG0)
53 TG0_WDT_LEVEL (TIMG0)
54 TG1_T0_LEVEL (TIMG1)
55 TG1_T1_LEVEL (TIMG1)
56 TG1_WDT_LEVEL (TIMG1)
57 SYSTIMER_TARGET0 (SYSTIMER)
58 SYSTIMER_TARGET1 (SYSTIMER)
59 SYSTIMER_TARGET2 (SYSTIMER)
60 APB_SARADC
61 MCPWM0
62 PCNT
63 PARL_IO
64 SLC0 (SLCHOST)
65 SLC1 (SLCHOST)
66 DMA_IN_CH0 (DMA)
67 DMA_IN_CH1 (DMA)
68 DMA_IN_CH2 (DMA)
69 DMA_OUT_CH0 (DMA)
70 DMA_OUT_CH1 (DMA)
71 DMA_OUT_CH2 (DMA)
72 SPI2
73 AES
74 SHA
75 RSA
76 ECC

## Licence text in the file
Copyright 2025 Espressif Systems (Shanghai) PTE LTD Licensed under the Apache License, Version 2.0 (the "License"); you may not use this file except in compliance with the License. You may obtain a copy of the License at http://www.apache.org/licenses/LICENSE-2.0 Unless required by applicable law or agreed to in writing, software distributed under the License is distributed on an "AS IS" BASIS, WITHOUT WARRANTIES OR CONDITIONS OF ANY KIND, either express or implied. See the License for the specific language governing permissions and limitations under the License.
