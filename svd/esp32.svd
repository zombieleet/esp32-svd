# ESP32 register map
Vendor: ESPRESSIF SYSTEMS (SHANGHAI) CO., LTD.; Series: ESP32 Series; File version: 17
32-bit MCU & 2.4 GHz Wi-Fi & Bluetooth/Bluetooth LE
CPU: Xtensa LX6 r0p0, little endian, no MPU, FPU, 0 interrupt priority bits
Address unit: 32 bits
Registers are 32-bit, read-write, reset 0x0 unless marked. A register's access mark holds for its fields unless they carry their own. Offsets are from the block's base; lines under a group give offsets from that group; [hi:lo] are bit positions; {n}, {i} and the like mark numbered series; 'fields as' and 'values as' point back to an identical list; <NAME> marks a mode.

## Memory map
0x3FF00000 DPORT size 0x5C0 — DPORT Peripheral
0x3FF01000 AES size 0x40 — AES (Advanced Encryption Standard) Accelerator
0x3FF02000 RSA size 0x1C — RSA (Rivest Shamir Adleman) Accelerator
0x3FF03000 SHA size 0xC0 — SHA (Secure Hash Algorithm) Accelerator
0x3FF10000 MMU_TABLE size 0x100 — PRO CPU flash cache MMU table
0x3FF12000 APP_MMU_TABLE size 0x100 — APP CPU flash cache MMU table
0x3FF40000 UART0 size 0x78 — UART (Universal Asynchronous Receiver-Transmitter) Controller 0
0x3FF42000 SPI1 size 0x110 — SPI (Serial Peripheral Interface) Controller 1
0x3FF43000 SPI0 size 0x110 — SPI (Serial Peripheral Interface) Controller 0
0x3FF44000 GPIO size 0x5CC — General Purpose Input/Output
0x3FF44F00 GPIO_SD size 0x2C — Sigma-Delta Modulation
0x3FF46000 FLASH_ENCRYPTION size 0x2C — FLASH_ENCRYPTION Peripheral
0x3FF47000 FRC_TIMER size 0x14 — FRC_TIMER Peripheral
0x3FF48000 RTC_CNTL size 0xDC — Real-Time Clock Control
0x3FF48400 RTC_IO size 0xCC — Low-power Input/Output
0x3FF48800 SENS size 0xA8 — SENS Peripheral
0x3FF48C00 RTC_I2C size 0x3C — Low-power I2C (Inter-Integrated Circuit) Controller
0x3FF49000 IO_MUX size 0x94 — Input/Output Multiplexer
0x3FF4B000 HINF size 0x34 — HINF Peripheral
0x3FF4C000 UHCI1 size 0xC8 — Universal Host Controller Interface 1
0x3FF4F000 I2S0 size 0xB4 — I2S (Inter-IC Sound) Controller 0
0x3FF50000 UART1 size 0x78 — UART (Universal Asynchronous Receiver-Transmitter) Controller 1
0x3FF53000 I2C0 size 0x9C — I2C (Inter-Integrated Circuit) Controller 0
0x3FF54000 UHCI0 size 0xC8 — Universal Host Controller Interface 0
0x3FF55000 SLCHOST size 0x104 — SLCHOST Peripheral
0x3FF56000 RMT size 0xF8 — Remote Control
0x3FF57000 PCNT size 0xB8 — Pulse Count Controller
0x3FF58000 SLC size 0x14C — SLC Peripheral
0x3FF59000 LEDC size 0x198 — LED Control PWM (Pulse Width Modulation)
0x3FF5A000 EFUSE size 0x124 — eFuse Controller
0x3FF5CC00 NRX size 0x4 — NRX Peripheral
0x3FF5D000 BB size 0x4 — BB Peripheral
0x3FF5E000 MCPWM0 size 0x128 — Motor Control Pulse Width Modulator (MCPWM) Peripheral
0x3FF5F000 TIMG0 size 0xB0 — Timer Group 0
0x3FF60000 TIMG1 size 0xB0 — Timer Group 1
0x3FF64000 SPI2 size 0x110 — SPI (Serial Peripheral Interface) Controller 2
0x3FF65000 SPI3 size 0x110 — SPI (Serial Peripheral Interface) Controller 3
0x3FF66000 APB_CTRL size 0x44 — APB (Advanced Peripheral Bus) Controller
0x3FF67000 I2C1 size 0x9C — I2C (Inter-Integrated Circuit) Controller 1
0x3FF68000 SDHOST size 0xA4 — SD/MMC Host Controller
0x3FF69000 GMAC_DMA size 0x38 — Ethernet DMA configuration and control registers
0x3FF69800 EMAC_EXT size 0x18 — Ethernet Clock, PHY type, and SRAM configuration registers
0x3FF6A000 GMAC size 0x78 — Ethernet MAC configuration and control registers
0x3FF6B000 TWAI0 size 0x6C — Two-Wire Automotive Interface
0x3FF6C000 MCPWM1 size 0x128 — Motor Control Pulse-Width Modulation 1
0x3FF6D000 I2S1 size 0xB4 — I2S (Inter-IC Sound) Controller 1
0x3FF6E000 UART2 size 0x78 — UART (Universal Asynchronous Receiver-Transmitter) Controller 2
0x3FF71000 BTDM size 0x1000 — Dual mode Bluetooth Core peripheral
0x3FF73000 WIFI size 0x2100 — MAC controller for Wi-Fi peripheral
0x60035000 RNG size 0x4 — Hardware Random Number Generator

## Interrupts
0 WIFI_MAC (DPORT)
1 WIFI_NMI (DPORT)
2 WIFI_BB (DPORT)
3 BT_MAC (DPORT)
4 BT_BB (DPORT)
5 BT_BB_NMI (DPORT)
6 RWBT (DPORT)
7 RWBLE (DPORT)
8 RWBT_NMI (DPORT)
9 RWBLE_NMI (DPORT)
12 UHCI0
13 UHCI1
14 TG0_T0_LEVEL (TIMG0)
15 TG0_T1_LEVEL (TIMG0)
16 TG0_WDT_LEVEL (TIMG0)
17 TG0_LACT_LEVEL (TIMG0)
18 TG1_T0_LEVEL (TIMG1)
19 TG1_T1_LEVEL (TIMG1)
20 TG1_WDT_LEVEL (TIMG1)
21 TG1_LACT_LEVEL (TIMG1)
22 GPIO
23 GPIO_NMI (GPIO)
24 FROM_CPU_INTR0 (DPORT)
25 FROM_CPU_INTR1 (DPORT)
26 FROM_CPU_INTR2 (DPORT)
27 FROM_CPU_INTR3 (DPORT)
28 SPI0
29 SPI1
30 SPI2
31 SPI3
32 I2S0
33 I2S1
34 UART0
35 UART1
36 UART2
37 SDIO_HOST (DPORT)
38 ETH_MAC (DPORT)
39 MCPWM0
40 MCPWM1 (MCPWM0)
41 MCPWM2 (MCPWM0)
42 MCPWM3 (MCPWM0)
43 LEDC
44 EFUSE
45 TWAI0
46 RTC_CORE (RTC_CNTL)
47 RMT
48 PCNT
49 I2C_EXT0 (I2C0)
50 I2C_EXT1 (I2C1)
51 RSA
52 SPI1_DMA (SPI1)
53 SPI2_DMA (SPI2)
54 SPI3_DMA (SPI3)
55 WDT (DPORT)
56 TIMER1 (LEDC)
57 TIMER2 (LEDC)
58 TG0_T0_EDGE (TIMG0)
59 TG0_T1_EDGE (TIMG0)
60 TG0_WDT_EDGE (TIMG0)
61 TG0_LACT_EDGE (TIMG0)
62 TG1_T0_EDGE (TIMG1)
63 TG1_T1_EDGE (TIMG1)
64 TG1_WDT_EDGE (TIMG1)
65 TG1_LACT_EDGE (TIMG1)
66 MMU_IA (DPORT)
67 MPU_IA (DPORT)
68 CACHE_IA (DPORT)

## Licence text in the file
Copyright 2025 Espressif Systems (Shanghai) PTE LTD Licensed under the Apache License, Version 2.0 (the "License"); you may not use this file except in compliance with the License. You may obtain a copy of the License at http://www.apache.org/licenses/LICENSE-2.0 Unless required by applicable law or agreed to in writing, software distributed under the License is distributed on an "AS IS" BASIS, WITHOUT WARRANTIES OR CONDITIONS OF ANY KIND, either express or implied. See the License for the specific language governing permissions and limitations under the License.
