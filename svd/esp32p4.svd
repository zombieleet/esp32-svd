# ESP32-P4 register map
Vendor: ESPRESSIF SYSTEMS (SHANGHAI) CO., LTD.; Series: ESP32 P-Series; File version: 3
32-bit RISC-V MCU
CPU: RV32IMAFC r0p0, little endian, no MPU, FPU, 0 interrupt priority bits
Address unit: 32 bits
Registers are 32-bit, read-write, reset 0x0 unless marked. A register's access mark holds for its fields unless they carry their own. Offsets are from the block's base; lines under a group give offsets from that group; [hi:lo] are bit positions; {n}, {i} and the like mark numbered series; 'fields as' and 'values as' point back to an identical list; <NAME> marks a mode.

## Memory map
0x20000000 CLINT size 0xC000 — Core Local Interrupts
0x20010000 CLINT_OTHER_CORE size 0xC000 — Core Local Interrupts of the other core
0x20800000 CLIC size 0x10C0 — Core Local Interrupt Controller
0x3FF04000 TRACE0 size 0x4C — TRACE0 Peripheral
0x3FF05000 TRACE1 size 0x4C — TRACE1 Peripheral
0x3FF06000 ASSIST_DEBUG size 0x100 — Debug Assist
0x3FF10000 CACHE size 0x3F0 — CACHE Peripheral
0x50000000 USB_HS
0x50040000 USB_FS
0x50080000 USB_WRAP size 0xC — USB_WRAP Peripheral
0x50081000 DMA size 0x234 — DMA (Direct Memory Access) Controller
0x50082000 PAU size 0x44 — PAU Peripheral
0x50083000 SDHOST size 0xB0 — SD/MMC Host Controller
0x50084000 H264 size 0x118 — H264 Encoder (Core)
0x50085000 AHB_DMA size 0x2F0 — AHB_DMA Peripheral
0x50086000 JPEG size 0xB4 — JPEG Codec
0x50087000 PPA size 0x94 — PPA Peripheral
0x5008A000 AXI_DMA size 0x2DC — AXI_DMA Peripheral
0x5008C000 SPI0 size 0x15C — SPI (Serial Peripheral Interface) Controller 0
0x5008D000 SPI1 size 0xAC — SPI (Serial Peripheral Interface) Controller 1
0x5008E000 MEMSPI2 size 0x1000 — Memory SPI 2
0x5008F000 MEMSPI3 size 0x1000 — Memory SPI 3
0x50090000 AES size 0xC8 — AES (Advanced Encryption Standard) Accelerator
0x50091000 SHA size 0xF4 — SHA (Secure Hash Algorithm) Accelerator
0x50092000 RSA size 0x74 — RSA (Rivest Shamir Adleman) Accelerator
0x50093000 ECC size 0x138 — ECC (ECC Hardware Accelerator)
0x50094000 DS size 0xA60 — Digital Signature
0x50095000 HMAC size 0xA4 — HMAC (Hash-based Message Authentication Code) Accelerator
0x50096000 ECDSA size 0x168 — ECDSA (Elliptic Curve Digital Signature Algorithm) Accelerator
0x50098000 GMAC size 0x78 — Ethernet MAC configuration and control registers
0x50099000 GMAC_DMA size 0x38 — Ethernet DMA configuration and control registers
0x5009E000 PVT size 0x218 — PVT Peripheral
0x5009F000 MIPI_CSI_HOST size 0xA8 — MIPI Camera Interface Host
0x5009F800 MIPI_CSI_BRIDGE size 0x50 — MIPI Camera Interface Bridge
0x500A0000 MIPI_DSI_HOST size 0x128 — MIPI Display Interface Host
0x500A0800 MIPI_DSI_BRIDGE size 0x98 — MIPI Camera Interface Bridge
0x500A1000 ISP size 0x274 — ISP Peripheral
0x500A2000 RMT size 0xD0 — Remote Control
0x500A3000 BITSCRAMBLER size 0x40 — BITSCRAMBLER Peripheral
0x500A4000 AXI_ICM size 0x10 — AXI_ICM Peripheral
0x500A4400 ICM_AXI_QOS size 0x10 — AXI ICM QoS indirect-access window (base + 0x400)
0x500A7000 H264_DMA size 0x43C — H264 Encoder (DMA)
0x500C0000 MCPWM0 size 0x14C — Motor Control Pulse-Width Modulation 0
0x500C1000 MCPWM1 size 0x14C — Motor Control Pulse-Width Modulation 1
0x500C2000 TIMG0 size 0x8C — Timer Group 0
0x500C3000 TIMG1 size 0x8C — Timer Group 1
0x500C4000 I2C0 size 0x90 — I2C (Inter-Integrated Circuit) Controller 0
0x500C5000 I2C1 size 0x90 — I2C (Inter-Integrated Circuit) Controller 1
0x500C6000 I2S0 size 0x60 — I2S (Inter-IC Sound) Controller 0
0x500C7000 I2S1 — I2S (Inter-IC Sound) Controller 1
0x500C8000 I2S2 — I2S (Inter-IC Sound) Controller 2
0x500C9000 PCNT size 0x78 — Pulse Count Controller
0x500CA000 UART0 size 0x98 — UART (Universal Asynchronous Receiver-Transmitter) Controller 0
0x500CB000 UART1 size 0x98 — UART (Universal Asynchronous Receiver-Transmitter) Controller 1
0x500CC000 UART2 size 0x98 — UART (Universal Asynchronous Receiver-Transmitter) Controller 2
0x500CD000 UART3 size 0x98 — UART (Universal Asynchronous Receiver-Transmitter) Controller 3
0x500CE000 UART4 size 0x98 — UART (Universal Asynchronous Receiver-Transmitter) Controller 4
0x500CF000 PARL_IO size 0x58 — Parallel IO Controller
0x500D0000 SPI2 size 0x98 — SPI (Serial Peripheral Interface) Controller 2
0x500D1000 SPI3 size 0x98 — SPI (Serial Peripheral Interface) Controller 3
0x500D2000 USB_DEVICE size 0x8C — Full-speed USB Serial/JTAG Controller
0x500D3000 LEDC size 0x124 — LED Control PWM (Pulse Width Modulation)
0x500D5000 SOC_ETM size 0x228 — Event Task Matrix
0x500D6000 INTERRUPT_CORE0 size 0x244 — Interrupt Controller (Core 0)
0x500D6800 INTERRUPT_CORE1 size 0x244 — Interrupt Controller (Core 1)
0x500D7000 TWAI0 size 0x8C — Two-Wire Automotive Interface
0x500D8000 TWAI1 size 0x8C — Two-Wire Automotive Interface
0x500D9000 TWAI2 size 0x8C — Two-Wire Automotive Interface
0x500DA000 I3C_MST size 0x90 — I3C Controller (Master)
0x500DA000 I3C_MST_MEM size 0x108 — I3C_MST_MEM Peripheral
0x500DB000 I3C_SLV size 0x40 — I3C Controller (Slave)
0x500DC000 LCD_CAM size 0x4C — Camera/LCD Controller
0x500DE000 ADC size 0x7C — ADC (Analog to Digital Converter)
0x500DF000 UHCI0 size 0x84 — Universal Host Controller Interface 0
0x500E0000 GPIO size 0x5F0 — General Purpose Input/Output
0x500E0F00 GPIO_SD size 0xA4 — Sigma-Delta Modulation
0x500E1000 IO_MUX size 0xE8 — Input/Output Multiplexer
0x500E1200 IOMUX_MSPI_PIN size 0x30 — IOMUX_MSPI_PIN Peripheral
0x500E2000 SYSTIMER size 0x90 — System Timer
0x500E5000 HP_SYS size 0x1A4 — High-Power System
0x500E6000 HP_SYS_CLKRST size 0xF8 — HP_SYS_CLKRST Peripheral
0x50110000 LP_SYS size 0x124 — LP_SYS Peripheral
0x50111000 LP_AON_CLKRST size 0x54 — LP_AON_CLKRST Peripheral
0x50112000 LP_TIMER size 0x4C — Low-power Timer
0x50113000 LP_ANA size 0x144 — LP_ANA_PERI Peripheral
0x50114000 LP_HUK size 0x1A8 — LP_HUK Peripheral
0x50115000 PMU size 0x224 — PMU Peripheral
0x50116000 LP_WDT size 0x38 — Low-power Watchdog Timer
0x50120000 LP_PERI size 0x2C — LP_PERI Peripheral
0x50121000 LP_UART size 0x84 — Low-power UART (Universal Asynchronous Receiver-Transmitter) Controller
0x50122000 LP_I2C0 size 0x88 — Low-power I2C (Inter-Integrated Circuit) Controller 0
0x50124000 LP_I2C_ANA_MST size 0x3C — LP_I2C_ANA_MST Peripheral
0x50125000 LP_I2S0 size 0x98 — Low-power I2S (Inter-IC Sound) Controller 0
0x50126000 LP_TRNG
0x50127000 LP_ADC size 0x80 — Low-power Analog to Digital Converter
0x50128000 LP_TOUCH size 0x64 — LP_TOUCH Peripheral
0x5012A000 LP_GPIO size 0xEC — Low-power General Purpose Input/Output
0x5012B000 LP_IO_MUX size 0x54 — Low-power Input/Output Multiplexer
0x5012C000 LP_INTR size 0x18 — Low-power Interrupt Controller
0x5012D000 EFUSE size 0x3DC — eFuse Controller
0x5012F000 LP_TSENS size 0x38 — Low-power Temperature Sensor

## Interrupts
1 LP_WDT
2 LP_TIMER0 (LP_TIMER)
3 LP_TIMER1 (LP_TIMER)
6 PMU0 (PMU)
7 PMU1 (PMU)
8 LP_ANA
9 LP_ADC
10 LP_GPIO
11 LP_I2C (LP_I2C0)
12 LP_I2S0
14 LP_TOUCH
15 LP_TSENS
16 LP_UART
19 LP_SYS
20 LP_HUK
22 USB_DEVICE
23 SDIO_HOST (SDHOST)
24 DMA
25 SPI2
26 SPI3
27 I2S0
28 I2S1
29 I2S2
30 UHCI0
31 UART0
32 UART1
33 UART2
34 UART3
35 UART4
38 PWM0 (MCPWM0)
39 PWM1 (MCPWM1)
40 TWAI0
41 TWAI1
42 TWAI2
43 RMT
44 I2C0
45 I2C1
46 TG0_T0_LEVEL (TIMG0)
47 TG0_T1_LEVEL (TIMG0)
48 TG0_WDT_LEVEL (TIMG0)
49 TG1_T0_LEVEL (TIMG1)
50 TG1_T1_LEVEL (TIMG1)
51 TG1_WDT_LEVEL (TIMG1)
52 LEDC
53 SYSTIMER_TARGET0 (SYSTIMER)
54 SYSTIMER_TARGET1 (SYSTIMER)
55 SYSTIMER_TARGET2 (SYSTIMER)
56 AHB_PDMA_IN_CH0 (AHB_DMA)
57 AHB_PDMA_IN_CH1 (AHB_DMA)
58 AHB_PDMA_IN_CH2 (AHB_DMA)
59 AHB_PDMA_OUT_CH0 (AHB_DMA)
60 AHB_PDMA_OUT_CH1 (AHB_DMA)
61 AHB_PDMA_OUT_CH2 (AHB_DMA)
62 AXI_PDMA_IN_CH0 (AHB_DMA)
63 AXI_PDMA_IN_CH1 (AHB_DMA)
64 AXI_PDMA_IN_CH2 (AHB_DMA)
65 AXI_PDMA_OUT_CH0 (AHB_DMA)
66 AXI_PDMA_OUT_CH1 (AHB_DMA)
67 AXI_PDMA_OUT_CH2 (AHB_DMA)
68 RSA
69 AES
70 SHA
71 ECC
74 GPIO
75 GPIO_INT1 (GPIO)
76 GPIO_INT2 (GPIO)
77 GPIO_INT3 (GPIO)
78 GPIO_PAD_COMP (GPIO)
79 FROM_CPU_INTR0 (HP_SYS)
80 FROM_CPU_INTR1 (HP_SYS)
81 FROM_CPU_INTR2 (HP_SYS)
82 FROM_CPU_INTR3 (HP_SYS)
83 CACHE
85 CSI_BRIDGE (MIPI_CSI_BRIDGE)
86 DSI_BRIDGE (MIPI_DSI_BRIDGE)
87 CSI (MIPI_CSI_HOST)
88 DSI (MIPI_DSI_HOST)
92 ETH_MAC (HP_SYS)
93 USB_HS
94 USB_HS_ENDP_MULTI_PROC (USB_HS)
95 JPEG
96 PPA
100 ISP
101 I3C (I3C_MST)
102 I3C_SLV
103 USB_FS
110 HP_SYS
111 PCNT
112 PAU
113 PARLIO_RX (PARL_IO)
114 PARLIO_TX (PARL_IO)
115 H264_DMA2D_OUT_CH0 (H264_DMA)
116 H264_DMA2D_OUT_CH1 (H264_DMA)
117 H264_DMA2D_OUT_CH2 (H264_DMA)
118 H264_DMA2D_OUT_CH3 (H264_DMA)
119 H264_DMA2D_OUT_CH4 (H264_DMA)
120 H264_DMA2D_IN_CH0 (H264_DMA)
121 H264_DMA2D_IN_CH1 (H264_DMA)
122 H264_DMA2D_IN_CH2 (H264_DMA)
123 H264_DMA2D_IN_CH3 (H264_DMA)
124 H264_DMA2D_IN_CH4 (H264_DMA)
125 H264_DMA2D_IN_CH5 (H264_DMA)
126 H264_REG (H264)
127 ASSIST_DEBUG

## Licence text in the file
Copyright 2026 Espressif Systems (Shanghai) PTE LTD Licensed under the Apache License, Version 2.0 (the "License"); you may not use this file except in compliance with the License. You may obtain a copy of the License at http://www.apache.org/licenses/LICENSE-2.0 Unless required by applicable law or agreed to in writing, software distributed under the License is distributed on an "AS IS" BASIS, WITHOUT WARRANTIES OR CONDITIONS OF ANY KIND, either express or implied. See the License for the specific language governing permissions and limitations under the License.
