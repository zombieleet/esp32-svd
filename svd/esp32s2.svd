# ESP32-S2 register map
Vendor: ESPRESSIF SYSTEMS (SHANGHAI) CO., LTD.; Series: ESP32 S-Series; File version: 20
32-bit MCU & 2.4 GHz Wi-Fi
CPU: Xtensa LX7 r0p0, little endian, no MPU, no FPU, 0 interrupt priority bits
Address unit: 32 bits
Registers are 32-bit, read-write, reset 0x0 unless marked. A register's access mark holds for its fields unless they carry their own. Offsets are from the block's base; lines under a group give offsets from that group; [hi:lo] are bit positions; {n}, {i} and the like mark numbered series; 'fields as' and 'values as' point back to an identical list; <NAME> marks a mode.

## Memory map
0x3F400000 UART0 size 0x7C — UART (Universal Asynchronous Receiver-Transmitter) Controller 0
0x3F402000 SPI1 — SPI (Serial Peripheral Interface) Controller 1
0x3F403000 SPI0 — SPI (Serial Peripheral Interface) Controller 0 (MEMSPI)
0x3F404000 GPIO size 0x634 — General Purpose Input/Output
0x3F404F00 GPIO_SD size 0x2C — Sigma-Delta Modulation
0x3F405000 FE2 size 0x4 — FE2 Peripheral
0x3F406000 FE size 0x4 — FE Peripheral
0x3F408000 RTC_CNTL size 0x138 — Real-Time Clock Control
0x3F408400 RTC_IO size 0xF0 — Low-power Input/Output
0x3F408800 SENS size 0x110 — SENS Peripheral
0x3F408C00 RTC_I2C size 0x7C — Low-power I2C (Inter-Integrated Circuit) Controller
0x3F409000 IO_MUX size 0xB4 — Input/Output Multiplexer
0x3F40F000 I2S0 size 0x88 — I2S (Inter-IC Sound) Controller 0
0x3F410000 UART1 size 0x7C — UART (Universal Asynchronous Receiver-Transmitter) Controller 1
0x3F413000 I2C0 size 0xA8 — I2C (Inter-Integrated Circuit) Controller 0
0x3F414000 UHCI0 size 0xBC — Universal Host Controller Interface 0
0x3F416000 RMT size 0xA0 — Remote Control
0x3F417000 PCNT size 0x68 — Pulse Count Controller
0x3F419000 LEDC size 0xD8 — LED Control PWM (Pulse Width Modulation)
0x3F41A000 EFUSE size 0x1D0 — eFuse Controller
0x3F41CC00 NRX size 0x400 — NRX Peripheral
0x3F41D000 BB size 0x4 — BB Peripheral
0x3F41F000 TIMG0 size 0xB4 — Timer Group 0
0x3F420000 TIMG1 size 0xB4 — Timer Group 1
0x3F423000 SYSTIMER size 0x54 — System Timer
0x3F424000 SPI2 size 0x108 — SPI (Serial Peripheral Interface) Controller 2 (GPSPI)
0x3F425000 SPI3 size 0x108 — SPI (Serial Peripheral Interface) Controller 3
0x3F426000 SYSCON size 0xA0 — SYSCON Peripheral
0x3F427000 I2C1 size 0xA8 — I2C (Inter-Integrated Circuit) Controller 1
0x3F42B000 TWAI0 size 0x6C — Two-Wire Automotive Interface
0x3F437000 SPI4 size 0x108 — SPI (Serial Peripheral Interface) Controller 4
0x3F439000 USB_WRAP size 0xC — USB_WRAP Peripheral
0x3F440000 APB_SARADC size 0x68 — SAR (Successive Approximation Register) Analog-to-Digital Converter
0x3F4C0000 SYSTEM size 0x94 — System Configuration Registers
0x3F4C1000 PMS size 0x10C — Permissions Controller
0x3F4C2000 INTERRUPT_CORE0 size 0x190 — Interrupt Controller (Core 0)
0x3F4C3000 COPY_DMA — Copy DMA Controller
0x3F4CF000 DEDICATED_GPIO size 0x30 — DEDICATED_GPIO Peripheral
0x6000E000 I2C_ANA_MST — I2C Analog Master
0x60033000 WIFI size 0x2200 — MAC controller for Wi-Fi peripheral
0x60035000 RNG size 0x4 — Hardware Random Number Generator
0x6003A000 AES size 0xBC — AES (Advanced Encryption Standard) Accelerator
0x6003A100 XTS_AES size 0x60 — XTS-AES-128 Flash Encryption
0x6003B000 SHA size 0xF0 — SHA (Secure Hash Algorithm) Accelerator
0x6003C000 RSA size 0x34 — RSA (Rivest Shamir Adleman) Accelerator
0x6003D000 DS size 0xA5C — Digital Signature
0x6003E000 HMAC size 0x9C — HMAC (Hash-based Message Authentication Code) Accelerator
0x6003F000 CRYPTO_DMA — Crypto DMA Controller
0x60080000 USB_FS size 0x2A0 — USB OTG (On-The-Go)
0x61800000 EXTMEM size 0x140 — External Memory
0x61801000 MMU_TABLE size 0x600 — External memory cache MMU table

## Interrupts
0 WIFI_MAC (INTERRUPT_CORE0)
1 WIFI_NMI (INTERRUPT_CORE0)
2 WIFI_PWR (INTERRUPT_CORE0)
3 WIFI_BB (INTERRUPT_CORE0)
4 BT_MAC (INTERRUPT_CORE0)
5 BT_BB (INTERRUPT_CORE0)
6 BT_BB_NMI (INTERRUPT_CORE0)
7 RWBT (INTERRUPT_CORE0)
8 RWBLE (INTERRUPT_CORE0)
9 RWBT_NMI (INTERRUPT_CORE0)
10 RWBLE_NMI (INTERRUPT_CORE0)
11 SLC0 (INTERRUPT_CORE0)
12 SLC1 (INTERRUPT_CORE0)
13 UHCI0
14 UHCI1 (UHCI0)
15 TG0_T0_LEVEL (TIMG0)
16 TG0_T1_LEVEL (TIMG0)
17 TG0_WDT_LEVEL (TIMG0)
18 TG0_LACT_LEVEL (TIMG0)
19 TG1_T0_LEVEL (TIMG1)
20 TG1_T1_LEVEL (TIMG1)
21 TG1_WDT_LEVEL (TIMG1)
22 TG1_LACT_LEVEL (TIMG1)
23 GPIO
24 GPIO_NMI (GPIO)
25 GPIO_INTR_2 (GPIO)
26 GPIO_NMI_2 (GPIO)
27 DEDICATED_GPIO
28 FROM_CPU_INTR0 (INTERRUPT_CORE0)
29 FROM_CPU_INTR1 (INTERRUPT_CORE0)
30 FROM_CPU_INTR2 (INTERRUPT_CORE0)
31 FROM_CPU_INTR3 (INTERRUPT_CORE0)
32 SPI1
33 SPI2
34 SPI3
35 I2S0
36 I2S1 (I2S0)
37 UART0
38 UART1
39 UART2 (UART1)
40 SDIO_HOST (INTERRUPT_CORE0)
45 LEDC
46 EFUSE
47 TWAI0
48 USB (USB_FS)
49 RTC_CORE (RTC_CNTL)
50 RMT
51 PCNT
52 I2C_EXT0 (I2C0)
53 I2C_EXT1 (I2C1)
54 RSA
55 SHA
56 AES
57 SPI2_DMA (SPI2)
58 SPI3_DMA (SPI3)
59 WDT (INTERRUPT_CORE0)
60 TIMER1 (LEDC)
61 TIMER2 (LEDC)
62 TG0_T0_EDGE (TIMG0)
63 TG0_T1_EDGE (TIMG0)
64 TG0_WDT_EDGE (TIMG0)
65 TG0_LACT_EDGE (TIMG0)
66 TG1_T0_EDGE (TIMG1)
67 TG1_T1_EDGE (TIMG1)
68 TG1_WDT_EDGE (TIMG1)
69 TG1_LACT_EDGE (TIMG1)
70 CACHE_IA (INTERRUPT_CORE0)
71 SYSTIMER_TARGET0 (SYSTIMER)
72 SYSTIMER_TARGET1 (SYSTIMER)
73 SYSTIMER_TARGET2 (SYSTIMER)
75 PMS_PRO_IRAM0_ILG (PMS)
76 PMS_PRO_DRAM0_ILG (PMS)
77 PMS_PRO_DPORT_ILG (PMS)
78 PMS_PRO_AHB_ILG (PMS)
79 PMS_PRO_CACHE_ILG (PMS)
80 PMS_DMA_APB_I_ILG (PMS)
81 PMS_DMA_RX_I_ILG (PMS)
82 PMS_DMA_TX_I_ILG (PMS)
83 SPI0_REJECT_CACHE (SPI0)
84 DMA_COPY (COPY_DMA)
85 SPI4_DMA (SPI4)
86 SPI4
87 ICACHE_PRELOAD (INTERRUPT_CORE0)
88 DCACHE_PRELOAD (INTERRUPT_CORE0)
89 APB_ADC (APB_SARADC)
90 CRYPTO_DMA
91 CPU_PERI_ERR (INTERRUPT_CORE0)
92 APB_PERI_ERR (INTERRUPT_CORE0)
93 DCACHE_SYNC (INTERRUPT_CORE0)
94 ICACHE_SYNC (INTERRUPT_CORE0)

## Licence text in the file
Copyright 2025 Espressif Systems (Shanghai) PTE LTD Licensed under the Apache License, Version 2.0 (the "License"); you may not use this file except in compliance with the License. You may obtain a copy of the License at http://www.apache.org/licenses/LICENSE-2.0 Unless required by applicable law or agreed to in writing, software distributed under the License is distributed on an "AS IS" BASIS, WITHOUT WARRANTIES OR CONDITIONS OF ANY KIND, either express or implied. See the License for the specific language governing permissions and limitations under the License.
