# ESP32-S31 register map
Vendor: ESPRESSIF SYSTEMS (SHANGHAI) CO., LTD.; Series: ESP32 S-Series; File version: 1
32-bit RISC-V MCU & 2.4 GHz Wi-Fi & Bluetooth 5 (LE) & IEEE 802.15.4
CPU: RV32IMAFC r0p0, little endian, no MPU, FPU, 0 interrupt priority bits
Address unit: 32 bits
Registers are 32-bit, read-write, reset 0x0 unless marked. A register's access mark holds for its fields unless they carry their own. Offsets are from the block's base; lines under a group give offsets from that group; [hi:lo] are bit positions; {n}, {i} and the like mark numbered series; 'fields as' and 'values as' point back to an identical list; <NAME> marks a mode.

## Memory map
0x10000000 CLINT size 0xC000 — Core Local Interrupts
0x10010000 CLINT_OTHER_CORE size 0xC000 — Core Local Interrupts of the other core
0x10800000 CLIC size 0x10C0 — Core Local Interrupt Controller
0x20103000 IEEE802154 — IEEE802154 Peripheral
0x20109C00 MODEM_SYSCON
0x2010F000 MODEM_LPCON
0x2010F800 I2C_ANA_MST — I2C_ANA_MST Peripheral
0x20300000 USB_OTG_HS size 0x5D0 — USB_OTG_HS Peripheral
0x20341000 PAU size 0x2C — PAU Peripheral
0x20342000 SDHOST size 0xB0 — SD/MMC Host Controller
0x20343000 AHB_DMA size 0x370 — AHB_DMA Peripheral
0x20344000 JPEG size 0xB4 — JPEG Codec
0x20345000 PPA size 0x94 — PPA Peripheral
0x20346000 DMA2D size 0x2EC — DMA2D Peripheral
0x20348000 AXI_DMA size 0x2DC — AXI_DMA Peripheral
0x20350000 GMAC size 0x200 — Ethernet MAC
0x20351000 GMAC_DMA size 0x200 — Ethernet DMA
0x20354000 PVT size 0x228 — PVT Peripheral
0x20355000 RMT size 0xD0 — Remote Control
0x20356000 BITSCRAMBLER size 0x50 — BITSCRAMBLER Peripheral
0x20357000 ASRC size 0x80 — ASRC Peripheral
0x20359000 CNNT_SYS size 0x1000 — Connectivity System Registers
0x20381000 MCPWM0 size 0x160 — Motor Control Pulse-Width Modulation 0
0x20382000 MCPWM1 size 0x160 — Motor Control Pulse-Width Modulation 1
0x20383000 MCPWM2 size 0x160 — MCPWM2 Peripheral
0x20384000 MCPWM3 size 0x160 — MCPWM3 Peripheral
0x20385000 I2C0 size 0x90 — I2C (Inter-Integrated Circuit) Controller 0
0x20386000 I2C1 size 0x90 — I2C (Inter-Integrated Circuit) Controller 1
0x20387000 I2S0 size 0x90 — I2S (Inter-IC Sound) Controller 0
0x20388000 I2S1 size 0x90 — I2S (Inter-IC Sound) Controller 1
0x20389000 PCNT size 0x78 — Pulse Count Controller
0x2038A000 UART0 size 0x98 — UART (Universal Asynchronous Receiver-Transmitter) Controller 0
0x2038B000 UART1 size 0x98 — UART (Universal Asynchronous Receiver-Transmitter) Controller 1
0x2038C000 UART2 size 0x98 — UART (Universal Asynchronous Receiver-Transmitter) Controller 2
0x2038D000 UART3 size 0x98 — UART (Universal Asynchronous Receiver-Transmitter) Controller 3
0x2038E000 PARL_IO size 0x58 — Parallel IO Controller
0x2038F000 SPI2 size 0x98 — SPI (Serial Peripheral Interface) Controller 2
0x20390000 SPI3 size 0x98 — SPI (Serial Peripheral Interface) Controller 3
0x20391000 USB_DEVICE size 0x78 — Full-speed USB Serial/JTAG Controller
0x20392000 LEDC0 size 0x12C — LEDC0 Peripheral
0x20393000 SOC_ETM size 0x278 — Event Task Matrix
0x20394000 TWAI0 size 0xC8 — Two-Wire Automotive Interface
0x20395000 TWAI1 size 0xC8 — Two-Wire Automotive Interface
0x20396000 LCD_CAM size 0x60 — Camera/LCD Controller
0x20398000 UHCI0 size 0x84 — Universal Host Controller Interface 0
0x20399000 SYSTIMER size 0x90 — System Timer
0x2039A000 ZERO_DET size 0x48 — ZERO_DET Peripheral
0x2039B000 CORDIC size 0x30 — CORDIC Peripheral
0x2039C000 LEDC1 size 0x12C — LEDC1 Peripheral
0x2039D000 PCNT1 size 0x78 — Pulse Count Controller
0x20500000 SPI0 size 0x180 — SPI (Serial Peripheral Interface) Controller 0
0x20501000 SPI1 size 0xB0 — SPI (Serial Peripheral Interface) Controller 1
0x20502000 MEMSPI2 size 0x1000 — Memory SPI 2
0x20503000 MEMSPI3 size 0x1000 — Memory SPI 3
0x20504000 TEE size 0x158 — TEE Peripheral
0x20504400 HP_APM size 0x14C — HP_APM Peripheral
0x20504800 HP_MEM_APM size 0xD8 — HP_MEM_APM Peripheral
0x20504C00 CPU_APM size 0xB8 — CPU_APM Peripheral
0x20505000 HP_PERI0_PMS size 0xA4 — HP_PERI0_PMS Peripheral
0x20506000 KEYMNG size 0xDC — KEYMNG Peripheral
0x20508000 AES size 0xCC — AES (Advanced Encryption Standard) Accelerator
0x20509000 SHA size 0x290 — SHA (Secure Hash Algorithm) Accelerator
0x2050A000 RSA size 0x7C — RSA (Rivest Shamir Adleman) Accelerator
0x2050B000 ECC size 0x13C — ECC (ECC Hardware Accelerator)
0x2050C000 DS size 0xA64 — Digital Signature
0x2050D000 HMAC size 0xA8 — HMAC (Hash-based Message Authentication Code) Accelerator
0x2050E000 ECDSA size 0x1A0 — ECDSA (Elliptic Curve Digital Signature Algorithm) Accelerator
0x2050F000 RMA size 0x4C — RMA Peripheral
0x20510000 ICM_SYS size 0x1000 — ICM AXI Interconnect System
0x20511000 AXI_PERF_MON size 0x678 — AXI_PERF_MON Peripheral
0x20580000 TIMG0 size 0x8C — Timer Group 0
0x20581000 TIMG1 size 0x8C — Timer Group 1
0x20582000 IO_MUX size 0x100 — Input/Output Multiplexer
0x20583000 GPIO size 0x6A4 — General Purpose Input/Output
0x20583E00 GPIO_EXT size 0xA0 — GPIO_EXT Peripheral
0x20584000 IOMUX_MSPI_PIN size 0x30 — IOMUX_MSPI_PIN Peripheral
0x20585000 INTERRUPT_CORE0 size 0x800 — Interrupt Controller for Core 0
0x20585800 INTERRUPT_CORE1 size 0x800 — Interrupt Controller for Core 1
0x20586000 HP_SYS size 0x1B4 — High-Power System
0x20587000 HP_SYS_CLKRST size 0x1F0 — HP_SYS_CLKRST Peripheral
0x20588000 CNNT_IO_MUX size 0x40 — CNNT_IO_MUX Peripheral
0x20589000 HP_ALIVE_SYS size 0x84 — HP_ALIVE_SYS Peripheral
0x2058A000 HP_PERI1_PMS size 0xB4 — HP_PERI1_PMS Peripheral
0x20700000 LP_SYS size 0x1000 — LP System Registers
0x20701000 LP_AON_CLKRST size 0x70 — LP_AON_CLKRST Peripheral
0x20702000 LP_ANA size 0x38 — LP_ANA_PERI Peripheral
0x20703000 LP_HUK size 0x1A8 — LP_HUK Peripheral
0x20704000 PMU size 0x22C — PMU Peripheral
0x20705000 LP_TOUCH_AON size 0x100 — LP_TOUCH_AON Peripheral
0x20706000 LP_PERI_PMS size 0x94 — LP_PERI_PMS Peripheral
0x20706800 LP_TEE size 0x2C — Low-power Trusted Execution Environment
0x20706C00 LP_APM size 0xB8 — Low-power Access Permission Management Controller
0x20710000 LP_PERICLKRST size 0x54 — LP_PERICLKRST Peripheral
0x20712000 LP_IO_MUX size 0x1000
0x20713000 LP_GPIO size 0x98 — Low-power General Purpose Input/Output
0x20714000 LP_INTR size 0x1000 — LP Interrupt Controller
0x20715000 EFUSE size 0x3D8 — eFuse Controller
0x20800000 LP_TIMER size 0x4C — Low-power Timer
0x20801000 LP_WDT size 0x3C — Low-power Watchdog Timer
0x20802000 LP_CLKCALI size 0x10 — LP_CLKCALI Peripheral
0x20803000 RTCLOCKCALI1 size 0x10 — RTC Clock Calibration 1
0x20804000 LP_PWR size 0xA8 — LP_PWR Peripheral
0x20805000 LP_ADI size 0x14 — LP_ADI Peripheral
0x20810000 LP_UART size 0x84 — Low-power UART (Universal Asynchronous Receiver-Transmitter) Controller
0x20811000 LP_I2C size 0x90 — LP I2C Controller
0x20812000 LP_SPI size 0x1000 — LP SPI Controller
0x20813000 LP_I2C_ANA_MST size 0x1C — LP_I2C_ANA_MST Peripheral
0x20814000 TRNG size 0x50 — TRNG Peripheral
0x20815000 ADC size 0x8C — ADC (Analog to Digital Converter)
0x20816000 LP_TOUCH size 0x64 — LP_TOUCH Peripheral
0x20817000 LP_MAILBOX size 0x1000
0x20818000 LP_TSENS size 0x38 — Low-power Temperature Sensor
0x20819000 LP_AHB_DMA size 0x178 — LP_AHB_DMA Peripheral
0x2081A000 DAC size 0x44 — DAC Peripheral
0x2C000000 CACHE size 0x3F4 — CACHE Peripheral
0x2D000000 TRACE0 size 0x4C — TRACE0 Peripheral
0x2D001000 TRACE1 size 0x4C — TRACE1 Peripheral
0x2D002000 ASSIST_DEBUG size 0x11C — ASSIST_DEBUG (BUS_MONITOR) Peripheral
0x2D003000 MEM_MONITOR0 size 0x3C — MEM_MONITOR0 Peripheral
0x2D004000 MEM_MONITOR1 size 0x3C — MEM_MONITOR1 Peripheral

## Interrupts
1 AXI_PERF_MON
2 USB_DEVICE
3 SDIO_HOST (SDHOST)
4 SPI2
5 SPI3
6 I2S0
7 I2S1
8 UHCI0
9 UART0
10 UART1
11 UART2
12 UART3
13 LCD_CAM
14 PWM0 (MCPWM0)
15 PWM1 (MCPWM1)
16 PWM2 (MCPWM2)
17 PWM3 (MCPWM3)
18 TWAI0
19 TWAI0_TIMER (TWAI0)
20 TWAI1
21 TWAI1_TIMER (TWAI1)
22 RMT
23 I2C0
24 I2C1
25 TG0_T0_LEVEL (TIMG0)
26 TG0_T1_LEVEL (TIMG0)
27 TG0_WDT_LEVEL (TIMG0)
28 TG1_T0_LEVEL (TIMG1)
29 TG1_T1_LEVEL (TIMG1)
30 TG1_WDT_LEVEL (TIMG1)
31 LEDC0
32 LEDC1
33 SYSTIMER_TARGET0 (SYSTIMER)
34 SYSTIMER_TARGET1 (SYSTIMER)
35 SYSTIMER_TARGET2 (SYSTIMER)
36 AHB_PDMA_IN_CH0 (AHB_DMA)
37 AHB_PDMA_IN_CH1 (AHB_DMA)
38 AHB_PDMA_IN_CH2 (AHB_DMA)
39 AHB_PDMA_IN_CH3 (AHB_DMA)
40 AHB_PDMA_IN_CH4 (AHB_DMA)
41 AHB_PDMA_OUT_CH0 (AHB_DMA)
42 AHB_PDMA_OUT_CH1 (AHB_DMA)
43 AHB_PDMA_OUT_CH2 (AHB_DMA)
44 AHB_PDMA_OUT_CH3 (AHB_DMA)
45 AHB_PDMA_OUT_CH4 (AHB_DMA)
46 ASRC_CHNL0 (ASRC)
47 ASRC_CHNL1 (ASRC)
48 AXI_PDMA_IN_CH0 (AXI_DMA)
49 AXI_PDMA_IN_CH1 (AXI_DMA)
50 AXI_PDMA_IN_CH2 (AXI_DMA)
51 AXI_PDMA_OUT_CH0 (AXI_DMA)
52 AXI_PDMA_OUT_CH1 (AXI_DMA)
53 AXI_PDMA_OUT_CH2 (AXI_DMA)
54 RSA
55 AES
56 SHA
57 ECC
58 ECDSA
59 KM (KEYMNG)
60 RMA
61 GPIO
62 GPIO_INT1 (GPIO)
63 GPIO_INT2 (GPIO)
64 GPIO_INT3 (GPIO)
65 FROM_CPU_INTR0 (HP_SYS)
66 FROM_CPU_INTR1 (HP_SYS)
67 FROM_CPU_INTR2 (HP_SYS)
68 FROM_CPU_INTR3 (HP_SYS)
69 CACHE
70 CPU_APM_M0 (CPU_APM)
71 CPU_APM_M1 (CPU_APM)
72 CPU_APM_M2 (CPU_APM)
73 CPU_APM_M3 (CPU_APM)
74 HP_MEM_APM_M0 (HP_MEM_APM)
75 HP_MEM_APM_M1 (HP_MEM_APM)
76 HP_MEM_APM_M2 (HP_MEM_APM)
77 HP_MEM_APM_M3 (HP_MEM_APM)
78 HP_MEM_APM_M4 (HP_MEM_APM)
79 HP_MEM_APM_M5 (HP_MEM_APM)
84 HP_APM_M0 (HP_APM)
85 HP_APM_M1 (HP_APM)
86 HP_APM_M2 (HP_APM)
87 HP_APM_M3 (HP_APM)
88 HP_APM_M4 (HP_APM)
89 HP_APM_M5 (HP_APM)
90 HP_APM_M6 (HP_APM)
91 HP_PERI0_PMS
92 HP_PERI1_PMS
96 LPI (GMAC)
97 PMT (GMAC)
98 SBD (GMAC)
99 USB_OTG_HS
100 USB_OTG_HS_ENDP_MULTI_PROC (USB_OTG_HS)
101 JPEG
102 PPA
103 CORE0_TRACE (TRACE0)
104 CORE1_TRACE (TRACE1)
105 DMA2D_IN_CH0 (DMA2D)
106 DMA2D_IN_CH1 (DMA2D)
107 DMA2D_IN_CH2 (DMA2D)
108 DMA2D_OUT_CH0 (DMA2D)
109 DMA2D_OUT_CH1 (DMA2D)
110 DMA2D_OUT_CH2 (DMA2D)
111 DMA2D_OUT_CH3 (DMA2D)
113 HP_SYSREG (HP_SYS)
114 PCNT0 (PCNT)
115 PCNT1
116 HP_PAU (PAU)
117 HP_PARLIO_RX (PARL_IO)
118 HP_PARLIO_TX (PARL_IO)
119 ASSIST_DEBUG
120 MODEM_WIFI_MAC (MODEM_LPCON)
121 MODEM_WIFI_MAC_NMI (MODEM_LPCON)
122 MODEM_WIFI_PWR (MODEM_LPCON)
123 MODEM_WIFI_BB (MODEM_LPCON)
124 MODEM_BT_MAC (MODEM_LPCON)
125 MODEM_BT_BB (MODEM_LPCON)
126 MODEM_BT_BB_NMI (MODEM_LPCON)
127 MODEM_LP_TIMER (MODEM_LPCON)
128 MODEM_COEX (MODEM_LPCON)
129 MODEM_BLE_TIMER (MODEM_LPCON)
130 MODEM_BLE_SEC (MODEM_LPCON)
131 MODEM_I2C_MST (MODEM_LPCON)
132 MODEM_ZB_MAC (MODEM_LPCON)
133 MODEM_BT_MAC_INT1 (MODEM_LPCON)
134 CORDIC
135 ZERO_DET
136 LP_WDT
137 LP_TIMER0 (LP_TIMER)
138 LP_TIMER1 (LP_TIMER)
141 PMU0 (PMU)
142 PMU1 (PMU)
143 LP_ANA
144 LP_ADC (ADC)
145 LP_DAC (DAC)
146 LP_GPIO
149 LP_TOUCH
150 LP_TSENS
151 LP_UART
154 LP_TRNG (TRNG)
156 LP_APM_M0 (LP_APM)
157 LP_APM_M1 (LP_APM)
158 LP_APM_M2 (LP_APM)
159 LP_APM_M3 (LP_APM)
160 LP_PERI0_PMS (LP_PERI_PMS)
161 LP_PERI1_PMS (LP_PERI_PMS)
162 LP_HUK
164 LP_AHB_PDMA_IN_CH0 (LP_AHB_DMA)
165 LP_AHB_PDMA_IN_CH1 (LP_AHB_DMA)
166 LP_AHB_PDMA_OUT_CH0 (LP_AHB_DMA)
167 LP_AHB_PDMA_OUT_CH1 (LP_AHB_DMA)

## Licence text in the file
Copyright 2026 Espressif Systems (Shanghai) PTE LTD Licensed under the Apache License, Version 2.0 (the "License"); you may not use this file except in compliance with the License. You may obtain a copy of the License at http://www.apache.org/licenses/LICENSE-2.0 Unless required by applicable law or agreed to in writing, software distributed under the License is distributed on an "AS IS" BASIS, WITHOUT WARRANTIES OR CONDITIONS OF ANY KIND, either express or implied. See the License for the specific language governing permissions and limitations under the License.
