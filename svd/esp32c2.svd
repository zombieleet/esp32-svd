# ESP32-C2 register map
Vendor: ESPRESSIF SYSTEMS (SHANGHAI) CO., LTD.; Series: ESP32 C-Series; File version: 11
32-bit RISC-V MCU & 2.4 GHz Wi-Fi & Bluetooth 5 (LE)
CPU: RV32IMC r0p0, little endian, no MPU, no FPU, 0 interrupt priority bits
Address unit: 32 bits
Registers are 32-bit, read-write, reset 0x0 unless marked. A register's access mark holds for its fields unless they carry their own. Offsets are from the block's base; lines under a group give offsets from that group; [hi:lo] are bit positions; {n}, {i} and the like mark numbered series; 'fields as' and 'values as' point back to an identical list; <NAME> marks a mode.

## Memory map
0x60000000 UART0 size 0x84 — UART (Universal Asynchronous Receiver-Transmitter) Controller 0
0x60002000 SPI1 size 0xA8 — SPI (Serial Peripheral Interface) Controller 1
0x60003000 SPI0 size 0x48 — SPI (Serial Peripheral Interface) Controller 0
0x60004000 GPIO size 0x314 — General Purpose Input/Output
0x60008000 RTC_CNTL size 0x114 — Real-Time Clock Control
0x60008800 EFUSE size 0xC0 — eFuse Controller
0x60009000 IO_MUX size 0x5C — Input/Output Multiplexer
0x60010000 UART1 size 0x84 — UART (Universal Asynchronous Receiver-Transmitter) Controller 1
0x60013000 I2C0 size 0x88 — I2C (Inter-Integrated Circuit) Controller 0
0x60019000 LEDC size 0xB0 — LED Control PWM (Pulse Width Modulation)
0x6001D000 BB size 0x4 — BB Peripheral
0x6001F000 TIMG0 size 0x68 — Timer Group 0
0x60023000 SYSTIMER size 0x78 — System Timer
0x60024000 SPI2 size 0x98 — SPI (Serial Peripheral Interface) Controller 2
0x60026000 APB_CTRL size 0xA0 — APB (Advanced Peripheral Bus) Controller
0x60026000 RNG size 0x4 — Hardware Random Number Generator
0x6003B000 SHA size 0xB0 — SHA (Secure Hash Algorithm) Accelerator
0x6003E000 ECC size 0x18 — ECC (ECC Hardware Accelerator)
0x6003F000 DMA size 0x84 — DMA (Direct Memory Access) Controller
0x60040000 APB_SARADC size 0x68 — SAR (Successive Approximation Register) Analog-to-Digital Converter
0x6004D800 MODEM_CLKRST size 0x18 — MODEM_CLKRST Peripheral
0x6004E840 I2C_ANA_MST — I2C_ANA_MST Peripheral
0x600C0000 SYSTEM size 0xA0 — System Configuration Registers
0x600C1000 SENSITIVE size 0x48 — SENSITIVE Peripheral
0x600C2000 INTERRUPT_CORE0 size 0x150 — Interrupt Controller (Core 0)
0x600C4000 EXTMEM size 0x94 — External Memory
0x600C5000 MMU_TABLE size 0x100 — External memory cache MMU table
0x600CC000 XTS_AES size 0x30 — XTS-AES-128 Flash Encryption
0x600CE000 ASSIST_DEBUG size 0x38 — Debug Assist

## Interrupts
0 WIFI_MAC (INTERRUPT_CORE0)
1 WIFI_MAC_NMI (INTERRUPT_CORE0)
2 WIFI_PWR (INTERRUPT_CORE0)
3 WIFI_BB (INTERRUPT_CORE0)
4 BT_MAC (INTERRUPT_CORE0)
5 BT_BB (INTERRUPT_CORE0)
6 BT_BB_NMI (INTERRUPT_CORE0)
7 LP_TIMER (INTERRUPT_CORE0)
8 COEX (INTERRUPT_CORE0)
9 BLE_TIMER (INTERRUPT_CORE0)
10 BLE_SEC (INTERRUPT_CORE0)
11 I2C_MST (I2C0)
12 APB_CTRL
13 GPIO
14 GPIO_NMI (GPIO)
15 SPI1 (SPI2)
16 SPI2
17 UART0
18 UART1
19 LEDC
20 EFUSE
21 RTC_CORE (RTC_CNTL)
22 I2C_EXT0 (I2C0)
23 TG0_T0_LEVEL (TIMG0)
24 TG0_WDT_LEVEL (TIMG0)
25 CACHE_IA (INTERRUPT_CORE0)
26 SYSTIMER_TARGET0 (SYSTIMER)
27 SYSTIMER_TARGET1 (SYSTIMER)
28 SYSTIMER_TARGET2 (SYSTIMER)
29 SPI_MEM_REJECT_CACHE (SPI0)
30 ICACHE_PRELOAD0 (INTERRUPT_CORE0)
31 ICACHE_SYNC0 (INTERRUPT_CORE0)
32 APB_ADC (APB_SARADC)
33 DMA_CH0 (DMA)
34 SHA
35 ECC (INTERRUPT_CORE0)
36 FROM_CPU_INTR0 (INTERRUPT_CORE0)
37 FROM_CPU_INTR1 (INTERRUPT_CORE0)
38 FROM_CPU_INTR2 (INTERRUPT_CORE0)
39 FROM_CPU_INTR3 (INTERRUPT_CORE0)
40 ASSIST_DEBUG — Assist debug interrupt
41 ETS_CORE0_PIF_PMS_SIZE (INTERRUPT_CORE0)

## Licence text in the file
Copyright 2025 Espressif Systems (Shanghai) PTE LTD Licensed under the Apache License, Version 2.0 (the "License"); you may not use this file except in compliance with the License. You may obtain a copy of the License at http://www.apache.org/licenses/LICENSE-2.0 Unless required by applicable law or agreed to in writing, software distributed under the License is distributed on an "AS IS" BASIS, WITHOUT WARRANTIES OR CONDITIONS OF ANY KIND, either express or implied. See the License for the specific language governing permissions and limitations under the License.
