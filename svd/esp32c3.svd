# ESP32-C3 register map
Vendor: ESPRESSIF SYSTEMS (SHANGHAI) CO., LTD.; Series: ESP32 C-Series; File version: 19
32-bit RISC-V MCU & 2.4 GHz Wi-Fi & Bluetooth 5 (LE)
CPU: RV32IMC r0p0, little endian, no MPU, no FPU, 0 interrupt priority bits
Address unit: 32 bits
Registers are 32-bit, read-write, reset 0x0 unless marked. A register's access mark holds for its fields unless they carry their own. Offsets are from the block's base; lines under a group give offsets from that group; [hi:lo] are bit positions; {n}, {i} and the like mark numbered series; 'fields as' and 'values as' point back to an identical list; <NAME> marks a mode.

## Memory map
0x60000000 UART0 size 0x84 — UART (Universal Asynchronous Receiver-Transmitter) Controller 0
0x60002000 SPI1 size 0xA8 — SPI (Serial Peripheral Interface) Controller 1
0x60003000 SPI0 size 0x48 — SPI (Serial Peripheral Interface) Controller 0
0x60004000 GPIO size 0x31C — General Purpose Input/Output
0x60004F00 GPIO_SD size 0x1C — Sigma-Delta Modulation
0x60005000 FE2 size 0x4 — need des
0x60006000 FE size 0x4 — need des
0x60008000 RTC_CNTL size 0x12C — Real-Time Clock Control
0x60008800 EFUSE size 0x1CC — eFuse Controller
0x60009000 IO_MUX size 0x60 — Input/Output Multiplexer
0x6000E040 I2C_ANA_MST — I2C_MST_ANA Peripheral
0x60010000 UART1 size 0x84 — UART (Universal Asynchronous Receiver-Transmitter) Controller 1
0x60013000 I2C0 size 0x90 — I2C (Inter-Integrated Circuit) Controller 0
0x60014000 UHCI0 size 0x84 — Universal Host Controller Interface 0
0x60016000 RMT size 0x78 — Remote Control
0x60019000 LEDC size 0xB0 — LED Control PWM (Pulse Width Modulation)
0x6001CC00 NRX size 0x4 — NRX Peripheral
0x6001D000 BB size 0x4 — BB Peripheral
0x6001F000 TIMG0 size 0x68 — Timer Group 0
0x60020000 TIMG1 size 0x68 — Timer Group 1
0x60023000 SYSTIMER size 0x78 — System Timer
0x60024000 SPI2 size 0x94 — SPI (Serial Peripheral Interface) Controller 2
0x60026000 APB_CTRL size 0xA0 — APB (Advanced Peripheral Bus) Controller
0x60026000 RNG size 0x4 — Hardware Random Number Generator
0x6002B000 TWAI0 size 0x6C — Two-Wire Automotive Interface
0x6002D000 I2S0 size 0x5C — I2S (Inter-IC Sound) Controller 0
0x60033000 WIFI size 0x2200 — MAC controller for Wi-Fi peripheral
0x6003A000 AES size 0xBC — AES (Advanced Encryption Standard) Accelerator
0x6003B000 SHA size 0xB0 — SHA (Secure Hash Algorithm) Accelerator
0x6003C000 RSA size 0x74 — RSA (Rivest Shamir Adleman) Accelerator
0x6003D000 DS size 0x108C — Digital Signature
0x6003E000 HMAC size 0xA4 — HMAC (Hash-based Message Authentication Code) Accelerator
0x6003F000 DMA size 0x174 — DMA (Direct Memory Access) Controller
0x60040000 APB_SARADC size 0x68 — SAR (Successive Approximation Register) Analog-to-Digital Converter
0x60043000 USB_DEVICE size 0x50 — Full-speed USB Serial/JTAG Controller
0x600C0000 SYSTEM size 0xA0 — System Configuration Registers
0x600C1000 SENSITIVE size 0x178 — SENSITIVE Peripheral
0x600C2000 INTERRUPT_CORE0 size 0x19C — Interrupt Controller (Core 0)
0x600C4000 EXTMEM size 0x108 — External Memory
0x600C5000 MMU_TABLE size 0x200 — External memory cache MMU table
0x600CC000 XTS_AES size 0x30 — XTS-AES-128 Flash Encryption
0x600CE000 ASSIST_DEBUG size 0xA0 — Debug Assist

## Interrupts
0 WIFI_MAC (INTERRUPT_CORE0)
1 WIFI_MAC_NMI (INTERRUPT_CORE0)
2 WIFI_PWR (INTERRUPT_CORE0)
3 WIFI_BB (INTERRUPT_CORE0)
4 BT_MAC (INTERRUPT_CORE0)
5 BT_BB (INTERRUPT_CORE0)
6 BT_BB_NMI (INTERRUPT_CORE0)
7 RWBT (INTERRUPT_CORE0)
8 RWBLE (INTERRUPT_CORE0)
9 RWBT_NMI (INTERRUPT_CORE0)
10 RWBLE_NMI (INTERRUPT_CORE0)
11 I2C_MASTER (I2C0)
12 SLC0 (INTERRUPT_CORE0)
13 SLC1 (INTERRUPT_CORE0)
14 APB_CTRL
15 UHCI0
16 GPIO
17 GPIO_NMI (GPIO)
18 SPI1
19 SPI2
20 I2S0
21 UART0
22 UART1
23 LEDC
24 EFUSE
25 TWAI0
26 USB_DEVICE
27 RTC_CORE (RTC_CNTL)
28 RMT
29 I2C_EXT0 (I2C0)
30 TIMER1 (LEDC)
31 TIMER2 (LEDC)
32 TG0_T0_LEVEL (TIMG0)
33 TG0_WDT_LEVEL (TIMG0)
34 TG1_T0_LEVEL (TIMG1)
35 TG1_WDT_LEVEL (TIMG1)
36 CACHE_IA (INTERRUPT_CORE0)
37 SYSTIMER_TARGET0 (SYSTIMER)
38 SYSTIMER_TARGET1 (SYSTIMER)
39 SYSTIMER_TARGET2 (SYSTIMER)
40 SPI_MEM_REJECT_CACHE (SPI0)
41 ICACHE_PRELOAD0 (INTERRUPT_CORE0)
42 ICACHE_SYNC0 (INTERRUPT_CORE0)
43 APB_ADC (APB_SARADC)
44 DMA_CH0 (DMA)
45 DMA_CH1 (DMA)
46 DMA_CH2 (DMA)
47 RSA
48 AES
49 SHA
50 FROM_CPU_INTR0 (INTERRUPT_CORE0)
51 FROM_CPU_INTR1 (INTERRUPT_CORE0)
52 FROM_CPU_INTR2 (INTERRUPT_CORE0)
53 FROM_CPU_INTR3 (INTERRUPT_CORE0)
54 ASSIST_DEBUG
55 DMA_APBPERI_PMS (DMA)
56 CORE0_IRAM0_PMS (INTERRUPT_CORE0)
57 CORE0_DRAM0_PMS (INTERRUPT_CORE0)
58 CORE0_PIF_PMS (INTERRUPT_CORE0)
59 CORE0_PIF_PMS_SIZE (INTERRUPT_CORE0)
60 BAK_PMS_VIOLATE (INTERRUPT_CORE0)
61 CACHE_CORE0_ACS (INTERRUPT_CORE0)

## Licence text in the file
Copyright 2025 Espressif Systems (Shanghai) PTE LTD Licensed under the Apache License, Version 2.0 (the "License"); you may not use this file except in compliance with the License. You may obtain a copy of the License at http://www.apache.org/licenses/LICENSE-2.0 Unless required by applicable law or agreed to in writing, software distributed under the License is distributed on an "AS IS" BASIS, WITHOUT WARRANTIES OR CONDITIONS OF ANY KIND, either express or implied. See the License for the specific language governing permissions and limitations under the License.
